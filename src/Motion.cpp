// Stepper motion module implementation (M0-T003).
//
// Steps are generated by the ESP32 RMT peripheral via FastAccelStepper
// (hardware-timed), replacing the AccelStepper polling task + portMUX of
// M0-T003: WiFi preemption can no longer jitter the pulse train.
#include "Motion.h"

#include "Text.h"

#include <FirmwareCore.h>

void Motion::begin() {
  pinMode(kEnPin, OUTPUT);
  digitalWrite(kEnPin, HIGH);
  pinMode(kEn2Pin, OUTPUT);
  digitalWrite(kEn2Pin, HIGH);

  engine_.init();
  stepper_ = engine_.stepperConnectToPin(kStepPin);
  if (stepper_ == nullptr) {
    // No RMT/driver resource for this pin; motion stays inert.
    Serial.println(msg(Msg::StepperInitFailed));
    return;
  }
  // dirHighCountsUp=false (#160): this FastAccelStepper version names the
  // polarity flag 'dirHighCountsUp' (default true). The first fix attempt
  // passed true believing it was an 'invert' flag with default false - a
  // no-op, caught on the bench (move +5 still drove the gantry DOWN).
  // false flips the DIR level per FastAccelStepper.cpp:57 so steps+ =
  // physically UP, matching the datum convention (M3 plan section 1).
  stepper_->setDirectionPin(kDirPin, /*dirHighCountsUp=*/false);

  outputRpm_ = feedMmPerMinToRpm(kDefaultFeedMmPerMin);
  applySettings();
}

void Motion::enable() {
  digitalWrite(kEnPin, LOW);
  digitalWrite(kEn2Pin, LOW);
  driverEnabled_ = true;
}

void Motion::disable() {
  if (stepper_ != nullptr) {
    stepper_->stopMove();
  }
  digitalWrite(kEnPin, HIGH);
  digitalWrite(kEn2Pin, HIGH);
  driverEnabled_ = false;
}

void Motion::stop() {
  if (stepper_ != nullptr) {
    stepper_->stopMove();
  }
}

void Motion::zero() {
  if (stepper_ != nullptr) {
    stepper_->setCurrentPosition(0);
  }
}

void Motion::setOutputRpm(float rpm) {
  // Machine travel cap (2026-10-11, operator): the rpm command must not
  // bypass the feed envelope - clamp to feedMmPerMinToRpm(MAX_MOVE_MM_PER_MIN)
  // so every speed command shares one physical limit. The command reply
  // reports the EFFECTIVE value (motion_.outputRpm()), like `feed` does.
  const float maxRpm = feedMmPerMinToRpm(MAX_MOVE_MM_PER_MIN);
  outputRpm_ = rpm > maxRpm ? maxRpm : rpm;
  applySettings();
}

void Motion::setAccelRpmPerS(float accelRpmPerS) {
  accelRpmPerS_ = accelRpmPerS;
  applySettings();
}

float Motion::outputRpm() {
  return outputRpm_;
}

float Motion::accelRpmPerS() {
  return accelRpmPerS_;
}

void Motion::startMoveToSteps(long targetSteps) {
  if (stepper_ == nullptr) {
    return;
  }
  enable();
  stepper_->moveTo(static_cast<int32_t>(targetSteps));
}

int8_t Motion::moveDirection() {
  if (stepper_ == nullptr || !stepper_->isRunning()) {
    return 0;
  }
  // In keep-running mode (startContinuous) targetPos() is not updated -
  // callers exclude runner motion before consulting this (#158 guard).
  const int32_t target = stepper_->targetPos();
  const int32_t current = stepper_->getCurrentPosition();
  return target > current ? 1 : (target < current ? -1 : 0);
}

void Motion::startContinuous(int direction) {
  if (stepper_ == nullptr) {
    return;
  }
  enable();
  if (direction >= 0) {
    stepper_->runForward();
  } else {
    stepper_->runBackward();
  }
}

void Motion::forceStop() {
  if (stepper_ != nullptr) {
    stepper_->forceStop();
    // forceStop() aborts the current command only; stopMove() clears a
    // still-queued moveTo so the motor cannot restart on its own.
    stepper_->stopMove();
  }
}

bool Motion::isEnabled() {
  return driverEnabled_;
}

bool Motion::isRunning() {
  return stepper_ != nullptr && stepper_->isRunning();
}

long Motion::steps() {
  return stepper_ != nullptr ? stepper_->getCurrentPosition() : 0;
}

float Motion::positionMm() {
  return spindleMmFromSteps(steps());
}

void Motion::applySettings() {
  if (stepper_ == nullptr) {
    return;
  }
  stepper_->setSpeedInHz(
      static_cast<uint32_t>(outputRpmToStepsPerSecond(outputRpm_)));
  stepper_->setAcceleration(
      static_cast<int32_t>(outputRpmToStepsPerSecond(accelRpmPerS_)));
  stepper_->applySpeedAcceleration();
}
